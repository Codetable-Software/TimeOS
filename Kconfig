## Kconfig
```kconfig
mainmenu "TimeOS v0.1.0 Configuration"

config TIMEOS
	bool "TimeOS kernel"
	default y

config TIMEOS_TIMER
	bool "Timer Kernel"
	depends on TIMEOS
	default y

config TIMEOS_NO_HZ
	bool "Tickless NO_HZ"
	depends on TIMEOS_TIMER
	default y

config TIMEOS_HRTIMER
	bool "High resolution timers"
	depends on TIMEOS_TIMER
	default y
```

## configs/generic-x86_64_defconfig
```kconfig
CONFIG_TIMEOS=y
CONFIG_TIMEOS_TIMER=y
CONFIG_TIMEOS_NO_HZ=y
CONFIG_TIMEOS_HRTIMER=y
CONFIG_TIMEOS_ARCH_X86_64=y
```

## kernel/sched/Kconfig
```kconfig
menu "TimeOS subsystem"
config TIMEOS_SUBSYSTEM
	bool "Enable subsystem"
	depends on TIMEOS
	default y
endmenu
```
